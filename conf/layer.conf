## conf/layer.conf
```bitbake
# We have a conf and classes directory, add to BBPATH
BBPATH .= ":${LAYERDIR}"

# We have recipes-* directories, add to BBFILES
BBFILES += "${LAYERDIR}/recipes-*/*/*.bb \
	${LAYERDIR}/recipes-*/*/*.bbappend"

# Define dynamic layers
BBFILES_DYNAMIC += " \
xilinx-tools:${LAYERDIR}/meta-xilinx-tools/recipes-*/*/*.bbappend \
"

BBFILE_COLLECTIONS += "meta-hum"
BBFILE_PATTERN_meta-hum = "^${LAYERDIR}/"
BBFILE_PRIORITY_meta-hum = "10"
LAYERSERIES_COMPAT_meta-hum = "langdale"
```

## project-spec/configs/rootfsconfigs/Kconfig.user
```kconfig
menu "user packages " 
config libftdi  
	 bool "libftdi"
	 help
	
config bluez5  
	 bool "bluez5"
	 help
	
config bonniePLUSPLUS  
	 bool "bonnie++"
	 help
	
config connman  
	 bool "connman"
	 help
	
config iperf3  
	 bool "iperf3"
	 help
	
config iw  
	 bool "iw"
	 help
	
config kernel-modules  
	 bool "kernel-modules"
	 help
	
config lmsensors-sensorsdetect  
	 bool "lmsensors-sensorsdetect"
	 help
	
config nano  
	 bool "nano"
	 help
	
config packagegroup-base-extended  
	 bool "packagegroup-base-extended"
	 help
	
config sds-lib  
	 bool "sds-lib"
	 help
	
config ultra96-misc  
	 bool "ultra96-misc"
	 help
	
config ultra96-wpa  
	 bool "ultra96-wpa"
	 help
	
config usb-gadget-ethernet  
	 bool "usb-gadget-ethernet"
	 help
	
config wilc  
	 bool "wilc"
	 help
	
config wilc3000-fw  
	 bool "wilc3000-fw"
	 help
	
config wpa-supplicant  
	 bool "wpa-supplicant"
	 help
	
endmenu
```
